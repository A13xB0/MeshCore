#include "WebInterface.h"

#ifdef ESP32

#include <WiFi.h>
#include <ESPAsyncWebServer.h>
#include <Update.h>
#include "web_assets.h"   // INDEX_HTML / UPDATE_HTML_GZ, generated by tools/embed_web.py

// CLI extensions implemented in main.cpp (fw.*, airlink.*, get net/ip); tried
// before the mesh's own handler so web-issued commands behave like serial/BLE.
static WebInterface::CmdHook g_cmd_hook = NULL;
void WebInterface::setCmdHook(CmdHook fn) { g_cmd_hook = fn; }

// run a CLI command and capture its reply
static String runCommand(MeshOSFull& mesh, const String& cmd) {
  char buf[200];
  strncpy(buf, cmd.c_str(), sizeof(buf) - 1);
  buf[sizeof(buf) - 1] = 0;
  char reply[200];
  reply[0] = 0;
  if (!(g_cmd_hook && g_cmd_hook(buf, reply)))
    mesh.handleCommand(0, buf, reply);
  return String(reply);
}

static String statusJson(MeshOSFull& mesh) {
  NodePrefs* p = mesh.getNodePrefs();
  char id[20];
  mesh::Utils::toHex(id, mesh.self_id.pub_key, 3);
  String j = "{";
  j += "\"name\":\"" + String(p->node_name) + "\",";
  j += "\"id\":\"" + String(id) + "\",";
  j += "\"ver\":\"" FIRMWARE_VERSION "\",";
  j += "\"uptime\":" + String(millis() / 1000);
  j += "}";
  return j;
}

void WebInterface::begin(const char* ap_ssid, const char* ap_pwd) {
  WiFi.mode(WIFI_AP);
  WiFi.softAP(ap_ssid, (ap_pwd && ap_pwd[0]) ? ap_pwd : NULL);

  AsyncWebServer* server = new AsyncWebServer(80);
  _server = server;
  MeshOSFull* mesh = &_mesh;

  server->on("/", HTTP_GET, [](AsyncWebServerRequest* req) {
    AsyncWebServerResponse* r = req->beginResponse_P(200, "text/html", INDEX_HTML, INDEX_HTML_len - 1);
    req->send(r);
  });

  server->on("/update", HTTP_GET, [](AsyncWebServerRequest* req) {
    AsyncWebServerResponse* r = req->beginResponse_P(200, "text/html", UPDATE_HTML_GZ, UPDATE_HTML_GZ_len);
    r->addHeader("Content-Encoding", "gzip");
    req->send(r);
  });

  // Manual firmware upload (the original ElegantOTA-style page served above).
  // update.html GETs the device identity, then streams a .bin by multipart POST.
  server->on("/update/identity", HTTP_GET, [mesh](AsyncWebServerRequest* req) {
    char id[20];
    mesh::Utils::toHex(id, mesh->self_id.pub_key, 3);
    req->send(200, "application/json",
              String("{\"id\":\"MeshCore-OTA\",\"hardware\":\"esp32\",\"node\":\"") + id + "\"}");
  });
  server->on("/update", HTTP_POST,
    [](AsyncWebServerRequest* req) {
      bool ok = !Update.hasError();
      AsyncWebServerResponse* r = req->beginResponse(ok ? 200 : 400, "text/plain", ok ? "OK" : "FAIL");
      r->addHeader("Connection", "close");
      req->send(r);
      if (ok) { delay(400); ESP.restart(); }
    },
    [](AsyncWebServerRequest* req, String fn, size_t index, uint8_t* data, size_t len, bool final) {
      if (index == 0) {
        Serial.printf("start ota: %s\n", fn.c_str());
        if (!Update.begin(UPDATE_SIZE_UNKNOWN)) Serial.println("OTA could not begin");
      }
      if (Update.write(data, len) != len) Update.printError(Serial);
      if (final) {
        if (Update.end(true)) Serial.printf("OTA ok: %u bytes\n", (unsigned)(index + len));
        else Serial.println("Could not end OTA");
      }
    });

  StatusProvider status_fn = _status_fn;
  server->on("/api/status", HTTP_GET, [mesh, status_fn](AsyncWebServerRequest* req) {
    req->send(200, "application/json", status_fn ? status_fn() : statusJson(*mesh));
  });

  server->on("/api/cmd", HTTP_POST, [mesh](AsyncWebServerRequest* req) {
    String cmd = req->hasParam("cmd", true) ? req->getParam("cmd", true)->value() : "";
    req->send(200, "text/plain", runCommand(*mesh, cmd));
  });

  server->on("/api/channels", HTTP_GET, [mesh](AsyncWebServerRequest* req) {
    req->send(200, "application/json", mesh->channelsJson());
  });

  StatusProvider prefs_fn = _prefs_fn;
  server->on("/api/prefs", HTTP_GET, [mesh, prefs_fn](AsyncWebServerRequest* req) {
    req->send(200, "application/json", prefs_fn ? prefs_fn()
              : ("{\"transport\":\"" + runCommand(*mesh, "get transport").substring(2) + "\"}"));
  });

  server->on("/api/hello", HTTP_GET, [mesh, status_fn](AsyncWebServerRequest* req) {
    req->send(200, "application/json", status_fn ? status_fn() : statusJson(*mesh));
  });
  server->on("/api/log", HTTP_GET, [mesh](AsyncWebServerRequest* req) {
    uint32_t since = req->hasParam("since") ? req->getParam("since")->value().toInt() : 0;
    req->send(200, "application/json", mesh->logJson(since));
  });
  server->on("/api/finder", HTTP_GET, [mesh](AsyncWebServerRequest* req) {
    req->send(200, "application/json", mesh->finderJson());
  });
  server->on("/api/regions", HTTP_GET, [mesh](AsyncWebServerRequest* req) {
    req->send(200, "application/json", mesh->regionsJson());
  });
  server->on("/api/trace", HTTP_GET, [mesh](AsyncWebServerRequest* req) {
    req->send(200, "application/json", mesh->traceJson());
  });
  for (const char* path : { "/api/nothing_left" }) {
    server->on(path, HTTP_GET, [](AsyncWebServerRequest* req) {
      req->send(200, "application/json", "{}");
    });
  }
  server->on("/api/graph", HTTP_GET, [mesh](AsyncWebServerRequest* req) {
    req->send(200, "application/json", mesh->graphJson());
  });

  server->begin();
  _running = true;
}

#endif
